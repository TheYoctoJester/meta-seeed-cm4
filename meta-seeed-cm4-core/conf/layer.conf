## meta-seeed-cm4-core/conf/layer.conf
```bitbake
# We have a conf and classes directory, add to BBPATH
BBPATH .= ":${LAYERDIR}"

# We have recipes-* directories, add to BBFILES
BBFILES += "${LAYERDIR}/recipes-*/*/*.bb \
            ${LAYERDIR}/recipes-*/*/*.bbappend"

BBFILE_COLLECTIONS += "meta-seeed-cm4-core"
BBFILE_PATTERN_meta-seeed-cm4-core = "^${LAYERDIR}/"
BBFILE_PRIORITY_meta-seeed-cm4-core = "6"

LAYERDEPENDS_meta-seeed-cm4-core = "core"
LAYERSERIES_COMPAT_meta-seeed-cm4-core = "honister"
```

## meta-seeed-cm4-core/conf/machine/seeed-reterminal.conf
```bitbake
#@TYPE: Machine
#@NAME: RaspberryPi 4 Development Board (64bit)
#@DESCRIPTION: Machine configuration for the RaspberryPi 4 in 64 bits mode

MACHINEOVERRIDES =. "raspberrypi4:"
require conf/machine/raspberrypi4-64.conf

RPI_KERNEL_DEVICETREE_OVERLAYS:append = " overlays/reTerminal.dtbo overlays/i2c3.dtbo"
PACKAGECONFIG:append_pn-qtbase = " eglfs "
KERNEL_MODULE_AUTOLOAD:rpi += "i2c-dev"
ENABLE_I2C = "1"
ENABLE_UART = "1"
```

## meta-seeed-cm4-demo/conf/distro/poky-seeed-demo.conf
```bitbake
DISTROOVERRIDES =. "poky:"
require conf/distro/poky.conf

DISTRO_FEATURES:remove = " x11 wayland vulkan"
```

## meta-seeed-cm4-demo/conf/layer.conf
```bitbake
# We have a conf and classes directory, add to BBPATH
BBPATH .= ":${LAYERDIR}"

# We have recipes-* directories, add to BBFILES
BBFILES += "${LAYERDIR}/recipes-*/*/*.bb \
            ${LAYERDIR}/recipes-*/*/*.bbappend"

BBFILE_COLLECTIONS += "meta-seeed-cm4-demo"
BBFILE_PATTERN_meta-seeed-cm4-demo = "^${LAYERDIR}/"
BBFILE_PRIORITY_meta-seeed-cm4-demo = "6"

LAYERDEPENDS_meta-seeed-cm4-demo = "core"
LAYERSERIES_COMPAT_meta-seeed-cm4-demo = "honister"
```

## meta-seeed-cm4-mender/conf/distro/poky-mender.conf
```bitbake
DISTROOVERRIDES =. "poky:"
require conf/distro/poky.conf

INHERIT += "mender-full"

DISTRO_FEATURES:append = " systemd"
VIRTUAL-RUNTIME_init_manager = "systemd"
DISTRO_FEATURES_BACKFILL_CONSIDERED = "sysvinit"
VIRTUAL-RUNTIME_initscripts = ""
```

## meta-seeed-cm4-mender/conf/layer.conf
```bitbake
# We have a conf and classes directory, add to BBPATH
BBPATH .= ":${LAYERDIR}"

# We have recipes-* directories, add to BBFILES
BBFILES += "${LAYERDIR}/recipes-*/*/*.bb \
            ${LAYERDIR}/recipes-*/*/*.bbappend"

BBFILE_COLLECTIONS += "meta-seeed-cm4-mender"
BBFILE_PATTERN_meta-seeed-cm4-mender = "^${LAYERDIR}/"
BBFILE_PRIORITY_meta-seeed-cm4-mender = "6"

LAYERDEPENDS_meta-seeed-cm4-mender = "core"
LAYERSERIES_COMPAT_meta-seeed-cm4-mender = "honister"
```

## meta-seeed-cm4-mender/conf/machine/seeed-reterminal-mender.conf
```bitbake
#@TYPE: Machine
#@NAME: RaspberryPi 4 Development Board (64bit)
#@DESCRIPTION: Machine configuration for the RaspberryPi 4 in 64 bits mode

MACHINEOVERRIDES =. "raspberrypi4:"
require conf/machine/seeed-reterminal.conf

# mender conf
RPI_USE_U_BOOT = "1"
MENDER_BOOT_PART_SIZE_MB = "64"
MENDER_STORAGE_TOTAL_SIZE_MB = "2048"
MACHINE_ESSENTIAL_EXTRA_RDEPENDS = "kernel-image kernel-devicetree"

MENDER_FEATURES_ENABLE:append = " mender-uboot mender-image-sd"
MENDER_FEATURES_DISABLE:append = " mender-grub mender-image-uefi"
```
